// SPDX-License-Identifier: GPL-2.0-only

/dts-v1/;

#include <skeleton32.dtsi>
#include <lk2nd.dtsi>

/ {
	// This is used by the bootloader to find the correct DTB
	qcom,board-id = <0x1000b 0x108 0x11000b 0x108 0x21000b 0x108>;
	qcom,msm-id = <0xf5 0x00 0x102 0x00 0x109 0x00 0x113 0x00>;

	model = "Coolpad 5360 (2)";
	compatible = "coolpad,5360", "qcom,msm8909", "lk2nd,device";
};
